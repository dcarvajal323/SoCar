/include/ "system-conf.dtsi"
/ {
	pwmgen: pwm_gen@43c00000 {
		clock-names = "s00_axi_aclk";
		clocks = <&clkc 15>;
		compatible = "xlnx,pwm-gen-1.0";
		reg = <0x43c00000 0x10000>;
		xlnx,s00-axi-addr-width = <0x4>;
		xlnx,s00-axi-data-width = <0x20>;
	};
};
